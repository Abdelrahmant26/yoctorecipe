## build/conf/bblayers.conf
```bitbake
# POKY_BBLAYERS_CONF_VERSION is increased each time build/conf/bblayers.conf
# changes incompatibly
POKY_BBLAYERS_CONF_VERSION = "2"

BBPATH = "${TOPDIR}"
BBFILES ?= ""

BBLAYERS ?= " \
  /home/yocto/poky/meta \
  /home/yocto/poky/meta-poky \
  /home/yocto/poky/meta-yocto-bsp \
  /home/yocto/poky/meta-raspberrypi \
  /home/yocto/poky/meta-audio-distro \
  /home/yocto/poky/meta-IVI \
  /home/yocto/poky/meta-openembedded/meta-oe \
  /home/yocto/poky/meta-openembedded/meta-webserver \
  /home/yocto/poky/meta-qt5 \
  "
```
